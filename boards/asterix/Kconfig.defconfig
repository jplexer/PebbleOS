## boards/obelix/Kconfig.defconfig
```kconfig
# SPDX-FileCopyrightText: 2026 Core Devices LLC
# SPDX-License-Identifier: Apache-2.0

if FUEL_GAUGE_THEVENIN

config FUEL_GAUGE_THEVENIN_RC_MILLIOHM
    default 456

config FUEL_GAUGE_THEVENIN_RC_TAU_MS
    default 67475

endif
```
