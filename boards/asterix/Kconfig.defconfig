## boards/asterix/Kconfig.defconfig
```kconfig
# SPDX-FileCopyrightText: 2026 Core Devices LLC
# SPDX-License-Identifier: Apache-2.0

if FLASH_SPI_NOR

config FLASH_SPI_NOR_GD25LQ255E
    default y

endif

if FUEL_GAUGE_THEVENIN

config FUEL_GAUGE_THEVENIN_RC_MILLIOHM
    default 561

config FUEL_GAUGE_THEVENIN_RC_TAU_MS
    default 98169

endif
```

## boards/obelix/Kconfig.defconfig
```kconfig
# SPDX-FileCopyrightText: 2026 Core Devices LLC
# SPDX-License-Identifier: Apache-2.0

if FLASH_SPI_NOR

config FLASH_SPI_NOR_GD25Q256E
    default y

endif

if FUEL_GAUGE_THEVENIN

config FUEL_GAUGE_THEVENIN_RC_MILLIOHM
    default 456

config FUEL_GAUGE_THEVENIN_RC_TAU_MS
    default 67475

endif
```
